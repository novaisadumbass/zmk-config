## boards/shields/ergonaut/Kconfig.defconfig
```kconfig
if SHIELD_ERGONAUT_DONGLE

config ZMK_KEYBOARD_NAME
    default "ergonaut"

config ZMK_SPLIT_ROLE_CENTRAL
    default y

config USB_HID_POLL_INTERVAL_MS
    default 1

config ZMK_SPLIT_BLE_CENTRAL_PERIPHERALS
    default 2

endif # SHIELD_ERGONAUT_DONGLE

if SHIELD_ERGONAUT_LEFT || SHIELD_ERGONAUT_RIGHT || SHIELD_ERGONAUT_DONGLE

config ZMK_SPLIT
    default y

endif # SHIELD_ERGONAUT_LEFT || SHIELD_ERGONAUT_RIGHT || SHIELD_ERGONAUT_DONGLE
```

## boards/shields/ergonaut/Kconfig.shield
```kconfig
config SHIELD_ERGONAUT_LEFT
    def_bool $(shields_list_contains,ergonaut_left)

config SHIELD_ERGONAUT_RIGHT
    def_bool $(shields_list_contains,ergonaut_right)

config SHIELD_ERGONAUT_DONGLE
    def_bool $(shields_list_contains,ergonaut_dongle)
```

## config/west.yml
```yaml
manifest:
  defaults:
    revision: v0.3
  remotes:
    - name: zmkfirmware
      url-base: https://github.com/zmkfirmware
    # Additional modules containing boards/shields/custom code can be listed here as well
    # See https://docs.zephyrproject.org/3.2.0/develop/west/manifest.html#projects
  projects:
    - name: zmk
      remote: zmkfirmware
      import: app/west.yml
    - name: ergonautkb-zmk-module
      url: https://github.com/ergonautkb/ergonautkb-zmk-module.git
      revision: main
      path: modules/ergonautkb-zmk-module
  self:
    path: config
```
